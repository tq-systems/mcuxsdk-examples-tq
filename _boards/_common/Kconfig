## _boards/_common/Kconfig
```kconfig
# This file contains common include directives for the ${board} board.
# For more information: https://mcuxpresso.nxp.com/mcuxsdk/latest/html/develop/sdk/custom_board_development.html

# The following include directives are common for all boards.
# The conditions must be defined in the boards prj.conf file.

# Include in common folder

config MCUX_PRJSEG_module.custom_board.common_folder
    bool "Common folder is present"
    default n
    help
        "Turns on the common inclusion of board, pinmux, clock files as well linker scripts."

config MCUX_PRJSEG_module.custom_board.boardfile_common_folder
    bool "Board file in Common"
    help
        "The custom board file is placed in the common folder."
    depends on MCUX_PRJSEG_module.custom_board.common_folder

config MCUX_PRJSEG_module.custom_board.clock_common_folder
    bool "Clock in Common"
    help
        "The custom clock file is placed in the common folder."
    depends on MCUX_PRJSEG_module.custom_board.common_folder

config MCUX_PRJSEG_module.custom_board.pinmux_common_folder
    bool "Pinmux in Common"
    help
        "The custom pinmux file is placed in the common folder."
    depends on MCUX_PRJSEG_module.custom_board.common_folder

config MCUX_PRJSEG_project.custom_board.hw_app_common_folder
    bool "app.h/hardware_init.c in Common"
    help
        "The custom board app/hardware_init.c file is placed in the common folder."
    depends on MCUX_PRJSEG_module.custom_board.common_folder

config MCUX_PRJSEG_module.custom_board.linker_common_folder
    bool "Linker in Common"
    help
        "The custom board linker file is placed in the common folder."
    depends on MCUX_PRJSEG_module.custom_board.common_folder

# Include in module folder

config MCUX_PRJSEG_module.custom_board.boardfile_project_folder
    bool "Board file in Project"
    default n
    help
        "The custom board file is placed in the app folder.."


config MCUX_PRJSEG_module.custom_board.clock_project_folder
    bool "Clock in Project"
    default n
    help
        "The custom board clock file is placed in the app folder."

config MCUX_PRJSEG_module.custom_board.pinmux_project_folder
    bool "Pinmux in Project"
    default n
    help
        "The custom board pinmux file is placed in the app folder."

config MCUX_PRJSEG_project.custom_board.hw_app_project_folder
    bool "app.h/hardware_init.c in Project"
    default n
    help
        "The custom board app/hardware_init.c file is placed in the app folder."

config MCUX_PRJSEG_module.custom_board.linker_project_folder
    bool "Linker in Project"
    help
        "The custom board linker file is placed in the app folder."

# Display support

config MCUX_PRJSEG_module.board.display_support
    bool "Enable Display Support"
```

## _boards/tqma117xl-mba117xl/Kconfig.sysbuild
```kconfig
# SPDX-License-Identifier: BSD-3-Clause
#
# Copyright 2025 NXP
#
# Copyright (c) 2025-2026 TQ-Systems GmbH <oss@ew.tq-group.com>,
# D-82229 Seefeld, Germany.
# Author: Isaac Lucas de Lima Yuki
#

config secondary_config
    string
    default "debug" if $(config) = "flexspi_nor_sdram_debug"
    default "release" if $(config) = "flexspi_nor_sdram_release"
    default "debug" if $(config) = "flexspi_nor_debug"
    default "release" if $(config) = "flexspi_nor_release"
    default "debug" if $(config) = "debug"
    default "release" if $(config) = "release"

config secondary_core_id
    string
    default "cm4" if $(core_id) = "cm7"
```

## _boards/tqma117xl-mba117xl/cm7/Kconfig
```kconfig
# SPDX-License-Identifier: BSD-3-Clause
#
# Copyright 2025 NXP
#
# Copyright (c) 2025-2026 TQ-Systems GmbH <oss@ew.tq-group.com>,
# D-82229 Seefeld, Germany.
# Author: Isaac Lucas de Lima Yuki
#

rsource "../xip/Kconfig"
```

## _boards/tqma8mpxl-mba8mpxl/Kconfig
```kconfig
# SPDX-License-Identifier: BSD-3-Clause
#
# Copyright 2024 NXP
#
# Copyright 2026 (c) TQ-Systems GmbH <oss@ew.tq-group.com>,
# D-82229 Seefeld, Germany.
# Author: Markus Niebel
#

rsource "../_common/Kconfig"

config MCUX_HW_BOARD_tqma8mpxl-mba8mpxl
    bool
    default y
    imply MCUX_HW_DEVICE_MIMX8ML8
```

## _boards/tqma8mpxs-mb-smarc-2/Kconfig
```kconfig
# SPDX-License-Identifier: BSD-3-Clause
#
# Copyright 2024 NXP
#
# Copyright 2026 (c) TQ-Systems GmbH <oss@ew.tq-group.com>,
# D-82229 Seefeld, Germany.
# Author: Markus Niebel
#

rsource "../_common/Kconfig"

config MCUX_HW_BOARD_tqma8mpxs-mb-smarc-2
    bool
    default y
    imply MCUX_HW_DEVICE_MIMX8ML8
```

## _boards/tqmba117xl/cm7/Kconfig
```kconfig
# SPDX-License-Identifier: BSD-3-Clause
#
# Copyright 2025 TQ-Systems GmbH <oss@ew.tq-group.com>,
# D-82229 Seefeld, Germany.
# Author: Isaac Lucas de Lima Yuki
#
# Copyright 2025 NXP
#

rsource "../xip/Kconfig"
```

## _boards/tqmba117xl/xip/Kconfig
```kconfig
# SPDX-License-Identifier: BSD-3-Clause
#
# Copyright 2025 TQ-Systems GmbH <oss@ew.tq-group.com>,
# D-82229 Seefeld, Germany.
# Author: Isaac Lucas de Lima Yuki
#

menu "Board Boot Header"
    config MCUX_COMPONENT_board.boot_header
        bool "Use board boot header"
endmenu
```

## _boards/tqmba93xxca/Kconfig
```kconfig
# SPDX-License-Identifier: BSD-3-Clause
#
# Copyright 2025 TQ-Systems GmbH <oss@ew.tq-group.com>,
# D-82229 Seefeld, Germany.
# Author: Isaac Lucas de Lima Yuki
#
# Copyright 2024 NXP
#

rsource "../_common/Kconfig"

config MCUX_HW_BOARD_tqmba93xxca
    bool
    default y
    imply MCUX_HW_DEVICE_MIMX9352
```

## west.yml
```yaml
# Copyright (c) 2021 Nordic Semiconductor ASA
# SPDX-License-Identifier: Apache-2.0

manifest:
  self:
    west-commands: scripts/west-commands.yml

  remotes:
    - name: nxp-mcuxpresso
      url-base: https://github.com/nxp-mcuxpresso

  projects:
    - name: mcuxsdk-manifests
      west-commands: scripts/west_commands.yml
      remote: nxp-mcuxpresso
      revision: v26.06.00-LTS
      path: mcuxpresso-sdk
      import:
      - submanifests/base.yml
      - submanifests/internal.yml
      - submanifests/devices/RT.yml
      - submanifests/devices/i.MX.yml
      - submanifests/middleware/eiq.yml
      - submanifests/middleware/multicore.yml
      - submanifests/rtos/rtos.yml

  group-filter:
  - -optional
  - -bifrost
  - -ble_cs_algo_private
  - -ble_cs_algo-restricted_private
  - -bluetooth_private
  - -fw_v19_nb
```
